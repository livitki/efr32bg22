## boards/custom/my_bg22_board/Kconfig.my_bg22_board
```kconfig
# Copyright (c) 2026 Mihail
# SPDX-License-Identifier: Apache-2.0

config BOARD_MY_BG22_BOARD
	select SOC_EFR32BG22C224F512GM40
```

## boards/custom/my_bg22_board/board.yml
```yaml
boards:
  - name: my_bg22_board
    full_name: My BG22 Custom Board
    vendor: custom
    socs:
      - name: efr32bg22c224f512gm40
```

## boards/custom/my_bg22_c112_board/Kconfig.my_bg22_c112_board
```kconfig
# Copyright (c) 2026 Mihail
# SPDX-License-Identifier: Apache-2.0

config BOARD_MY_BG22_C112_BOARD
	select SOC_EFR32BG22C222F352GM32
```

## boards/custom/my_bg22_c112_board/board.yml
```yaml
boards:
  - name: my_bg22_c112_board
    full_name: My BG22 C112 Custom Board
    vendor: custom
    socs:
      - name: efr32bg22c222f352gm32
```

## boards/custom/my_bg22_c112_board/my_bg22_c112_board_defconfig
```kconfig
# Copyright (c) 2026 Mihail
# SPDX-License-Identifier: Apache-2.0

CONFIG_ARM_MPU=y
CONFIG_FPU=y
CONFIG_CONSOLE=y
CONFIG_UART_CONSOLE=y
CONFIG_SERIAL=y
CONFIG_GPIO=y
CONFIG_HW_STACK_PROTECTION=y
CONFIG_REGULATOR=y
CONFIG_CMU_HFXO_FREQ=38400000
```
